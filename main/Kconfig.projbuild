## main/Kconfig.projbuild
```kconfig
menu "Clock"
config CLOCK_TIMEZONE
    string "POSIX time zone"
    default "CST-8"
    help
        RTC stores local time. Default is UTC+8 (China). After changing this,
        set the clock again over USB or the Wi-Fi management page.

config CLOCK_SYNC_HOUR
    int "Daily NTP synchronization hour (local time)"
    range 0 23
    default 8
    help
        Connect once per local day at or after this hour. A failed scheduled
        attempt is not retried every minute; use the management page to retry.

config CLOCK_NTP_SERVER
    string "NTP server"
    default "ntp.aliyun.com"
endmenu
```

## sdkconfig.defaults
```kconfig
CONFIG_IDF_TARGET="esp32s3"
CONFIG_ESPTOOLPY_FLASHSIZE_16MB=y
CONFIG_SPIRAM=y
CONFIG_SPIRAM_MODE_OCT=y
CONFIG_SPIRAM_SPEED_80M=y
CONFIG_SPIRAM_USE_MALLOC=y
CONFIG_ESP_DEFAULT_CPU_FREQ_MHZ_160=y
CONFIG_ESP_CONSOLE_USB_SERIAL_JTAG=y
CONFIG_LOG_DEFAULT_LEVEL_WARN=y
CONFIG_BOOTLOADER_LOG_LEVEL_WARN=y
CONFIG_FREERTOS_HZ=100
CONFIG_ESP_MAIN_TASK_STACK_SIZE=6144
# HTTPS LAN server and persistent P-256 self-signed identity.
CONFIG_ESP_HTTPS_SERVER_ENABLE=y
CONFIG_MBEDTLS_TLS_SERVER_AND_CLIENT=y
CONFIG_MBEDTLS_ECDH_C=y
CONFIG_MBEDTLS_ECDSA_C=y
CONFIG_MBEDTLS_ECP_DP_SECP256R1_ENABLED=y
CONFIG_MBEDTLS_KEY_EXCHANGE_ECDHE_ECDSA=y
CONFIG_MBEDTLS_PEM_PARSE_C=y
CONFIG_MBEDTLS_PEM_WRITE_C=y
# SDK FatFs R0.15 exFAT requires LFN; keep work buffers off the task stack.
CONFIG_FATFS_LFN_HEAP=y
CONFIG_FATFS_MAX_LFN=255
CONFIG_FATFS_API_ENCODING_UTF_8=y
CONFIG_PARTITION_TABLE_CUSTOM=y
CONFIG_PARTITION_TABLE_CUSTOM_FILENAME="partitions.csv"
CONFIG_BOOTLOADER_APP_ROLLBACK_ENABLE=y
CONFIG_ESP_TASK_WDT_EN=y
CONFIG_ESP_TASK_WDT_INIT=y
CONFIG_ESP_TASK_WDT_PANIC=y
CONFIG_ESP_TASK_WDT_TIMEOUT_S=20
CONFIG_BT_ENABLED=y
CONFIG_BT_CONTROLLER_ENABLED=y
CONFIG_BT_NIMBLE_ENABLED=y
CONFIG_ESP_PROTOCOMM_SUPPORT_SECURITY_VERSION_1=y
CONFIG_WIFI_PROV_AUTOSTOP_TIMEOUT=30
# CONFIG_WIFI_PROV_KEEP_BLE_ON_AFTER_PROV is not set
# CONFIG_ESP_PROTOCOMM_KEEP_BLE_ON_AFTER_BLE_STOP is not set
```
